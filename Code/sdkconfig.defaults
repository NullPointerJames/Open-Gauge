## Code/sdkconfig.defaults
```kconfig
# Target
CONFIG_IDF_TARGET="esp32s3"

# Flash
CONFIG_ESPTOOLPY_FLASHSIZE_16MB=y
CONFIG_ESPTOOLPY_FLASHFREQ_80M=y
CONFIG_ESPTOOLPY_FLASHMODE_QIO=y

# Partition table
CONFIG_PARTITION_TABLE_CUSTOM=y
CONFIG_PARTITION_TABLE_CUSTOM_FILENAME="partitions.csv"

# PSRAM (T-Circle-S3 uses OPI PSRAM)
CONFIG_SPIRAM=y
CONFIG_SPIRAM_MODE_OCT=y
CONFIG_SPIRAM_SPEED_80M=y
CONFIG_SPIRAM_USE_MALLOC=y
CONFIG_SPIRAM_ALLOW_BSS_SEG_EXTERNAL_MEMORY=y
CONFIG_SPIRAM_IGNORE_NOTFOUND=y

# I2C (for CST816S touch controller)
CONFIG_I2C_ENABLE_DEBUG_LOG=n
CONFIG_ESP_LCD_TOUCH_CST816S_DISABLE_READ_ID=y

# FreeRTOS
CONFIG_FREERTOS_HZ=1000
CONFIG_FREERTOS_UNICORE=n

# Logging
CONFIG_LOG_DEFAULT_LEVEL_INFO=y
CONFIG_COMPILER_OPTIMIZATION_SIZE=y
CONFIG_ESP_IPC_TASK_STACK_SIZE=3072
CONFIG_IPC_TASK_STACK_SIZE=3072

# WiFi
CONFIG_ESP_WIFI_SOFTAP_SUPPORT=y
CONFIG_LWIP_LOCAL_HOSTNAME="opengauge"

# SPIFFS
CONFIG_SPIFFS_USE_MAGIC=y
CONFIG_SPIFFS_USE_MAGIC_LENGTH=y

# HTTP server
CONFIG_HTTPD_MAX_REQ_HDR_LEN=1024
CONFIG_HTTPD_MAX_URI_LEN=512
CONFIG_HTTPD_PURGE_BUF_LEN=512

# NVS
CONFIG_NVS_ASSERT_ERROR_CHECK=n

# Stack sizes
CONFIG_ESP_MAIN_TASK_STACK_SIZE=8192
CONFIG_ESP_SYSTEM_EVENT_TASK_STACK_SIZE=4096

# LVGL (via esp_lvgl_port Kconfig)
# 466x466x2 = 434 KB per buffer -- lives in PSRAM via buff_spiram=true
CONFIG_LV_COLOR_DEPTH=16
CONFIG_LV_MEM_SIZE=65536
CONFIG_LV_USE_ARC=y
CONFIG_LV_USE_LABEL=y
CONFIG_LV_USE_BAR=y
CONFIG_LV_USE_IMG=y
CONFIG_LV_USE_LINE=y
CONFIG_LV_FONT_MONTSERRAT_12=y
CONFIG_LV_FONT_MONTSERRAT_14=y
CONFIG_LV_FONT_MONTSERRAT_20=y
CONFIG_LV_FONT_MONTSERRAT_28=y
CONFIG_LV_FONT_DEFAULT_MONTSERRAT_14=y
```
